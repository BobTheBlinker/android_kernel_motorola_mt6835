// SPDX-License-Identifier: GPL-2.0
/* Copyright (c) 2020 MediaTek Inc. */
/* CAMERA GPIO standardization */


#include "mediatek/cust_mt6835_camera_common.dtsi"
&kd_camera_hw1 {
	cust-sensor = "sc820acs_sunwin_rear_mipi_raw sc820cs_txd_front_mipi_raw  ov13b10_txd_rear_mipi_raw  gc13a0_lce_rear_mipi_raw gc05a2_lce_front_mipi_raw sc520cs_sunwin_front_mipi_raw gc08a8_ofilm_rear_mipi_raw gc08a8_sunwin_front_mipi_raw";
	//cust-sensor = " gc05a2_lce_front_mipi_raw sc520cs_sunwin_front_mipi_raw sc820acs_sunwin_rear_mipi_raw gc08a8_ofilm_rear_mipi_raw sc820cs_txd_front_mipi_raw sc820cs_txd_front_mipi_raw ov13b10_txd_rear_mipi_raw gc13a0_lce_rear_mipi_raw";
};
